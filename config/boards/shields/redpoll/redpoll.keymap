#include <behaviors.dtsi>
#include <dt-bindings/zmk/bt.h>
#include <dt-bindings/zmk/keys.h>
#include <dt-bindings/zmk/pointing.h>
/ {
    keymap {
        compatible = "zmk,keymap";
        base {
            bindings = <&mmv MOVE_DOWN>;
        };
    };
};
