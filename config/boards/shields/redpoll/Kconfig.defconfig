## config/boards/shields/redpoll/Kconfig.defconfig
```kconfig
if SHIELD_REDPOLL

config ZMK_KEYBOARD_NAME
	default "Redpoll"
	
endif

module = babopad
module-str = babopad
source "${ZEPHYR_BASE}/subsys/logging/Kconfig.template.log_config"
endif
```

## config/west.yml
```yaml
manifest:
  remotes:
    - name: zmkfirmware
      url-base: https://github.com/zmkfirmware
    - name: love-444
      url-base: https://github.com/love-444
  projects:
    - name: zmk
      remote: zmkfirmware
      revision: main
      import: app/west.yml
    - name: zmk-babopad
      remote: love-444
      revision: main
  self:
    path: config
     
```
